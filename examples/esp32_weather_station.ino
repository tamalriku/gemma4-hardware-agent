/*
 * esp32_weather_station.ino
 * ─────────────────────────
 * Example output sketch generated by Gemma 4 Hardware Agent.
 * Hardware: ESP32 + DHT22 + SSD1306 OLED (I2C) + WiFi → ThingSpeak
 *
 * Libraries (install via Arduino Library Manager):
 *   - DHT sensor library  (Adafruit)
 *   - Adafruit Unified Sensor
 *   - Adafruit SSD1306
 *   - Adafruit GFX Library
 *   - ThingSpeak
 */

#include <WiFi.h>
#include <DHT.h>
#include <Wire.h>
#include <Adafruit_GFX.h>
#include <Adafruit_SSD1306.h>
#include "ThingSpeak.h"

// ─── Pin Definitions ──────────────────────────────────────────────────────────
#define DHTPIN        4       // GPIO4 → DHT22 data pin
#define DHTTYPE       DHT22

// ─── OLED Config (128x64, I2C addr 0x3C) ─────────────────────────────────────
#define SCREEN_WIDTH  128
#define SCREEN_HEIGHT 64
#define OLED_RESET    -1      // Reset pin (-1 = share Arduino reset pin)
#define OLED_ADDR     0x3C

// ─── WiFi & ThingSpeak Credentials ───────────────────────────────────────────
#define WIFI_SSID       "YOUR_SSID"
#define WIFI_PASSWORD   "YOUR_PASSWORD"
#define TS_CHANNEL_ID   0000000UL   // Replace with your ThingSpeak Channel ID
#define TS_API_KEY      "YOUR_WRITE_API_KEY"

// ─── Timing ───────────────────────────────────────────────────────────────────
#define READ_INTERVAL_MS    5000    // Read sensor every 5 seconds
#define UPLOAD_INTERVAL_MS  30000   // Upload to ThingSpeak every 30 seconds

// ─── Global Objects ───────────────────────────────────────────────────────────
DHT dht(DHTPIN, DHTTYPE);
Adafruit_SSD1306 display(SCREEN_WIDTH, SCREEN_HEIGHT, &Wire, OLED_RESET);
WiFiClient wifiClient;

// ─── State Variables ──────────────────────────────────────────────────────────
float temperature = 0.0;
float humidity    = 0.0;
unsigned long lastReadTime   = 0;
unsigned long lastUploadTime = 0;

// ─────────────────────────────────────────────────────────────────────────────
void setup() {
  Serial.begin(115200);
  Serial.println("\n🌤  ESP32 Weather Station — Starting...");

  // Initialise DHT sensor
  dht.begin();

  // Initialise OLED display
  if (!display.begin(SSD1306_SWITCHCAPVCC, OLED_ADDR)) {
    Serial.println("❌ SSD1306 OLED not found. Check wiring!");
    while (true); // Halt if display not found
  }
  display.clearDisplay();
  display.setTextColor(SSD1306_WHITE);
  display.setTextSize(1);
  display.setCursor(0, 0);
  display.println("Weather Station");
  display.println("Connecting WiFi...");
  display.display();

  // Connect to WiFi
  connectWiFi();

  // Initialise ThingSpeak
  ThingSpeak.begin(wifiClient);

  Serial.println("✅ Setup complete!");
}

// ─────────────────────────────────────────────────────────────────────────────
void loop() {
  unsigned long now = millis();

  // ── Read sensor every READ_INTERVAL_MS ──────────────────────────────────────
  if (now - lastReadTime >= READ_INTERVAL_MS) {
    lastReadTime = now;
    readSensor();
    updateDisplay();
  }

  // ── Upload to ThingSpeak every UPLOAD_INTERVAL_MS ───────────────────────────
  if (now - lastUploadTime >= UPLOAD_INTERVAL_MS) {
    lastUploadTime = now;
    uploadToThingSpeak();
  }

  // ── Reconnect WiFi if dropped ───────────────────────────────────────────────
  if (WiFi.status() != WL_CONNECTED) {
    Serial.println("⚠️  WiFi lost, reconnecting...");
    connectWiFi();
  }
}

// ─────────────────────────────────────────────────────────────────────────────
void readSensor() {
  float h = dht.readHumidity();
  float t = dht.readTemperature(); // Celsius

  if (isnan(h) || isnan(t)) {
    Serial.println("❌ DHT22 read failed! Check wiring.");
    return;
  }

  temperature = t;
  humidity    = h;

  Serial.printf("🌡  Temp: %.1f°C  💧 Humidity: %.1f%%\n", temperature, humidity);
}

// ─────────────────────────────────────────────────────────────────────────────
void updateDisplay() {
  display.clearDisplay();

  // Header
  display.setTextSize(1);
  display.setCursor(0, 0);
  display.println("== Weather Station ==");

  // Temperature — large font
  display.setTextSize(2);
  display.setCursor(0, 16);
  display.printf("%.1f", temperature);
  display.setTextSize(1);
  display.setCursor(52, 16);
  display.println(" C");

  // Humidity
  display.setTextSize(2);
  display.setCursor(0, 38);
  display.printf("%.1f", humidity);
  display.setTextSize(1);
  display.setCursor(52, 38);
  display.println(" %");

  // WiFi status
  display.setTextSize(1);
  display.setCursor(0, 56);
  display.print(WiFi.status() == WL_CONNECTED ? "WiFi: OK" : "WiFi: --");

  display.display();
}

// ─────────────────────────────────────────────────────────────────────────────
void uploadToThingSpeak() {
  if (WiFi.status() != WL_CONNECTED) {
    Serial.println("⚠️  Skipping upload — no WiFi.");
    return;
  }

  ThingSpeak.setField(1, temperature);
  ThingSpeak.setField(2, humidity);

  int httpCode = ThingSpeak.writeFields(TS_CHANNEL_ID, TS_API_KEY);

  if (httpCode == 200) {
    Serial.println("☁️  ThingSpeak upload: ✅ OK");
  } else {
    Serial.printf("☁️  ThingSpeak upload failed. HTTP: %d\n", httpCode);
  }
}

// ─────────────────────────────────────────────────────────────────────────────
void connectWiFi() {
  Serial.printf("📶 Connecting to %s", WIFI_SSID);
  WiFi.begin(WIFI_SSID, WIFI_PASSWORD);

  int attempts = 0;
  while (WiFi.status() != WL_CONNECTED && attempts < 20) {
    delay(500);
    Serial.print(".");
    attempts++;
  }

  if (WiFi.status() == WL_CONNECTED) {
    Serial.printf("\n✅ WiFi connected! IP: %s\n", WiFi.localIP().toString().c_str());
  } else {
    Serial.println("\n❌ WiFi connection failed. Will retry in loop.");
  }
}
